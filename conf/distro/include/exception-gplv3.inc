## conf/distro/include/exception-gplv3.inc
```bitbake
#@DESCRIPTION: ST GPLv3 exception

#--------------------------
# License settings
#
# We dont want (L)GPL-3.0+
INCOMPATIBLE_LICENSE = "GPLv3.0 GPLv3 GPL-3.0 GPLv3+ LGPLv3.0 LGPLv3 LGPL-3.0 LGPLv3+"

OPENSTLINUX_ALLOW_GPLv3 = "gettext"
# for alsa-utils:
OPENSTLINUX_ALLOW_GPLv3 =+ " gettext bash "
# for systemd
OPENSTLINUX_ALLOW_GPLv3 =+ " bash readline "
# for udev:
OPENSTLINUX_ALLOW_GPLv3 =+ " gawk coreutils gdbm m4 "
# for bluez
OPENSTLINUX_ALLOW_GPLv3 =+ " python3-pycairo "
# for framework-tools-ui
OPENSTLINUX_ALLOW_GPLv3 =+ " grep dosfstools elfutils cpio gzip which "

OPENSTLINUX_ALLOW_GPLv3 += "${@bb.utils.contains('DISTRO_FEATURES', 'tpm', 'nano msmtp', '', d)}"

INCOMPATIBLE_LICENSE_EXCEPTIONS:LGPL-3.0-or-later = "${OPENSTLINUX_ALLOW_GPLv3}"
INCOMPATIBLE_LICENSE_EXCEPTIONS:LGPL-3.0-only = "${OPENSTLINUX_ALLOW_GPLv3}"
INCOMPATIBLE_LICENSE_EXCEPTIONS:GPL-3.0-only = "${OPENSTLINUX_ALLOW_GPLv3}"
INCOMPATIBLE_LICENSE_EXCEPTIONS:GPL-3.0-or-later = "${OPENSTLINUX_ALLOW_GPLv3}"
```

## conf/distro/include/openstlinux-default-naming.inc
```bitbake
#@DESCRIPTION: openstlinux default distro naming

# Init OPENSTLINUX_RELEASE flag to snapshot
OPENSTLINUX_RELEASE ??= "snapshot"

DISTRO = "openstlinux"
DISTRO_NAME = "ST OpenSTLinux (A Yocto Project Based Distro)"
DISTRO_VERSION = "5.0.8-${@bb.utils.contains('OPENSTLINUX_RELEASE', 'snapshot', 'snapshot-${DATE}', '${OPENSTLINUX_RELEASE}', d)}"
# Don't include the DATE variable in the sstate package signatures
DISTRO_VERSION[vardepsexclude] = "DATE"
DISTRO_CODENAME = "scarthgap"

# Warning: SDK_VENDOR does not contains a valid OS/ARCH name like : linux, arm
SDK_VENDOR = "-ostl_sdk"
SDK_VERSION := "${@'${DISTRO_VERSION}'.replace('snapshot-${DATE}','snapshot')}"
# Don't include the DATE variable in the sstate package signatures
SDK_VERSION[vardepsexclude] = "DATE"
SDKIMAGE_FEATURES ?= "dev-pkgs dbg-pkgs src-pkgs staticdev-pkgs ${@bb.utils.contains('DISTRO_FEATURES', 'api-documentation', 'doc-pkgs', '', d)}"


MAINTAINER = "Christophe Priouzeau <christophe.priouzeau@st.com>"

# Warning: TARGET_VENDOR does not contains a valid OS/ARCH name like : linux, arm
STM32MP_TARGETVENDOR ?= "-ostl"
TARGET_VENDOR = "${STM32MP_TARGETVENDOR}"

# Append distro name to each image name
IMAGE_BASENAME:append = "-${DISTRO}"

# Add image name for generated SDK and set default SDK install folder
SDK_NAME = "${IMAGE_LINK_NAME}-${SDK_ARCH}"
SDKPATHINSTALL = "/opt/st/${MACHINE}/${SDK_VERSION}"
# Don't include the DATE variable in the sstate package signatures
SDKPATHINSTALL[vardepsexclude] = "DATE"
```

## conf/distro/include/openstlinux.inc
```bitbake
# Distribution definition for openstlinux

# from dev manual:
# Your configuration file needs to set the following variables:
#
#      DISTRO_NAME [required]
#      DISTRO_VERSION [required]
#      DISTRO_FEATURES [required if creating from scratch]
#      DISTRO_EXTRA_RDEPENDS [optional]
#      DISTRO_EXTRA_RRECOMMENDS [optional]
#      TCLIBC [required if creating from scratch]

LOCALCONF_VERSION = "2"
LAYER_CONF_VERSION ?= "7"

# =========================================================================
# Set default distro naming
# =========================================================================
require openstlinux-default-naming.inc

# =========================================================================
# Enable uninative support
# =========================================================================
require conf/distro/include/no-static-libs.inc
require conf/distro/include/yocto-uninative.inc
INHERIT += "uninative"

# =========================================================================
# DISTRO features
# =========================================================================
DISTRO_FEATURES  = "alsa"
DISTRO_FEATURES += "argp"
DISTRO_FEATURES += "ext2"
DISTRO_FEATURES += "ext4"
DISTRO_FEATURES += "largefile"
DISTRO_FEATURES += "ipv4"
DISTRO_FEATURES += "ipv6"
DISTRO_FEATURES += "multiarch"
DISTRO_FEATURES += "pci"
DISTRO_FEATURES += "wifi"
DISTRO_FEATURES += "nfs"
DISTRO_FEATURES += "usbgadget"
DISTRO_FEATURES += "usbhost"
DISTRO_FEATURES += "xattr"
DISTRO_FEATURES += "zeroconf"
DISTRO_FEATURES += "bluetooth"
DISTRO_FEATURES += "bluez5"

# add support of gstreamer
DISTRO_FEATURES:append = " gstreamer "

# add support of optee
DISTRO_FEATURES:append = " optee "

# add support of splashscreen
DISTRO_FEATURES:append = " splashscreen "

# add support of wayland
DISTRO_FEATURES:append = " wayland pam "

# add support of X11
DISTRO_FEATURES:append = " x11 "

# add support of KDE (since OE thud version)
DISTRO_FEATURES:append = " kde "

# add support of systemd
DISTRO_FEATURES:append = " systemd polkit "

# add support of efi
DISTRO_FEATURES:append = " efi "

# add support of InitRD installation package
DISTRO_FEATURES:append = " initrd "

# add support of autoresize through InitRD
DISTRO_FEATURES:append = " autoresize "

# add support of tpm2
#DISTRO_FEATURES:append = " tpm2 "

# Disabling pulseaudio
#DISTRO_FEATURES_BACKFILL_CONSIDERED += "pulseaudio"
DISTRO_FEATURES:append = "pulseaudio"

# Disabling sysvinit
DISTRO_FEATURES_BACKFILL_CONSIDERED += "sysvinit"

VIRTUAL-RUNTIME_init_manager = "systemd"
VIRTUAL-RUNTIME_initscripts = "systemd-compat-units"

# =========================================================================
# Preferred version
# =========================================================================

# v4l-utils
#PREFERRED_VERSION_v4l-utils ?= "1.6.2"

# =========================================================================
# IMAGE addons
# =========================================================================
IMAGE_LINGUAS = "en-us en-gb"

LICENSE_FLAGS_ACCEPTED += " non-commercial commercial"

# X11 addons
DISTRO_EXTRA_RDEPENDS:append = " ${@bb.utils.contains('DISTRO_FEATURES', 'x11', 'xf86-video-modesetting', '', d)} "

# INITRD addons to image
DISTRO_EXTRA_RRECOMMENDS:append = " ${@bb.utils.contains('COMBINED_FEATURES', 'initrd', '${INITRD_PACKAGE}', '', d)} "
```

## conf/distro/include/st-default-distro-providers.inc
```bitbake
#@DESCRIPTION: ST default distro providers

PREFERRED_PROVIDER_libevent = "libevent-fb"
PREFERRED_PROVIDER_jpeg = "libjpeg-turbo"
PREFERRED_PROVIDER_jpeg-native = "libjpeg-turbo-native"

#--------------------------
# Preferred provider
# for openvt tools
PREFERRED_PROVIDER_console-tools = "kbd"

#--------------------------
# Preferred provider
# splash
SPLASH = "${@bb.utils.contains('COMBINED_FEATURES', 'splashscreen', 'psplash-drm', '', d)}"
PREFERRED_PROVIDER_virtual/psplash = "${@bb.utils.contains('COMBINED_FEATURES', 'splashscreen', 'psplash-drm', '', d)}"

#--------------------------
# Autoresize file system through InitRD
AUTORESIZE = "st-initrd"
INITRD_IMAGE = "st-image-resize-initrd"
INITRD_SHORTNAME = "uInitrd"
```

## conf/distro/include/st-default-distro-rules.inc
```bitbake
#@DESCRIPTION: ST default distro rules

# Set common distrooverrides for all ST distro
DISTROOVERRIDES .= ":openstlinuxcommon"

#--------------------------
# Mirror settings
#
YOCTOPROJECT_MIRROR_URL = "http://downloads.yoctoproject.org/mirror/sources/"

MIRRORS =+ "\
ftp://.*/.*    ${YOCTOPROJECT_MIRROR_URL} \n \
http://.*/.*   ${YOCTOPROJECT_MIRROR_URL} \n \
https://.*/.*  ${YOCTOPROJECT_MIRROR_URL} \n"

INHERIT += "own-mirrors"
SOURCE_MIRROR_URL ??= "${YOCTOPROJECT_MIRROR_URL}"

#--------------------------
# The CONNECTIVITY_CHECK_URI's are used to test whether we can succesfully
# fetch from the network (and warn you if not).
# URI's to check can be set in the CONNECTIVITY_CHECK_URIS variable
# using the same syntax as for SRC_URI. If the variable is not set
# the check is skipped
#
CONNECTIVITY_CHECK_URIS ?= "https://www.example.com/"

#--------------------------
# OELAYOUT_ABI allows us to notify users when the format of TMPDIR changes in
# an incompatible way. Such changes should usually be detailed in the commit
# that breaks the format and have been previously discussed on the mailing list
# with general agreement from the core team.
#
OELAYOUT_ABI = "12"

#--------------------------
# Add the manifest and the licenses file on image generated
COPY_LIC_MANIFEST = "1"

#--------------------------
# Tune build config display
#
BUILDCFG_VARS += "DISTRO_CODENAME"
BUILDCFG_VARS += "${@'ACCEPT_EULA_' + d.getVar('MACHINE')}"
BUILDCFG_VARS += "GCCVERSION"
BUILDCFG_VARS += "PREFERRED_PROVIDER_virtual/kernel"
BUILDCFG_VARS += "PREFERRED_VERSION_${PREFERRED_PROVIDER_virtual/kernel}"

#--------------------------
# Writes build information to target filesystem on /etc/build
#
IMAGE_BUILDINFO_VARS = "${BUILDCFG_VARS}"
INHERIT += "image-buildinfo"

# FORCE to use libgpiod 1.6.2
PREFERRED_VERSION_libgpiod = "1.6.2"
```

## conf/distro/openstlinux-eglfs.conf
```bitbake
#@NAME: openstlinux-eglfs
#@DESCRIPTION: OpenSTLinux featuring eglfs - no X11, no Wayland (with GPLv3 software)

require include/st-default-distro-rules.inc
require include/st-default-distro-providers.inc
require include/openstlinux.inc

# =========================================================================
# Distribution definition for: st-openstlinux-eglfs
# =========================================================================
DISTRO = "openstlinux-eglfs"
DISTRO_NAME = "ST OpenSTLinux - EGLfs - (A Yocto Project Based Distro)"

# =========================================================================
# DISTRO features
# =========================================================================
DISTRO_FEATURES:append = " opengl "
DISTRO_FEATURES:remove = " wayland x11 "

DISTRO_FEATURES:append = " gplv3 "

# FOR QT5 FORCE GIT PROTOCOL FOR HTTPS
#QT_GIT_PROTOCOL = "https"
```

## conf/distro/openstlinux-weston.conf
```bitbake
#@NAME: openstlinux-weston
#@DESCRIPTION: OpenSTLinux featuring Weston/Wayland (with GPLv3 software)

require include/st-default-distro-rules.inc
require include/st-default-distro-providers.inc
require include/openstlinux.inc

# =========================================================================
# Distribution definition for: st-openstlinux-weston-
# =========================================================================
DISTRO = "openstlinux-weston"
DISTRO_NAME = "ST OpenSTLinux - Weston - (A Yocto Project Based Distro)"

# =========================================================================
# DISTRO features
# =========================================================================
DISTRO_FEATURES:append = " opengl"
DISTRO_FEATURES:remove = " x11 "
# with X11
#PREFERRED_PROVIDER_virtual/xserver = "${@bb.utils.contains('DISTRO_FEATURES', 'x11 wayland', 'xwayland', 'xserver-xorg', d)}"

DISTRO_FEATURES:append = " gplv3 "
```

## conf/distro/openstlinux-x11.conf
```bitbake
#@NAME: openstlinux-x11
#@DESCRIPTION: OpenSTLinux featuring X11 (with GPLv3 software)

require include/st-default-distro-rules.inc
require include/st-default-distro-providers.inc
require include/openstlinux.inc

# =========================================================================
# Distribution definition for: st-openstlinux-x11
# =========================================================================
DISTRO = "openstlinux-x11"
DISTRO_NAME = "ST OpenSTLinux - X11 - (A Yocto Project Based Distro)"

# =========================================================================
# DISTRO features
# =========================================================================
DISTRO_FEATURES_append = " opengl"
DISTRO_FEATURES_remove = " wayland "

DISTRO_FEATURES_append = " gplv3 "

# With display manager: here lxdm
VIRTUAL-RUNTIME_graphical_init_manager = "lxdm"

# without display manager: here xserver-nodm-init
#VIRTUAL-RUNTIME_graphical_init_manager = "xserver-nodm-init"
#PREFERRED_VERSION_xserver-nodm-init = "3.0"
```

## conf/layer.conf
```bitbake
# We have a conf and classes directory, add to BBPATH
BBPATH .= ":${LAYERDIR}"

# We have a recipes-* directories, add to BBFILES
BBFILES += "${LAYERDIR}/recipes-*/*/*.bb \
            ${LAYERDIR}/recipes-*/*/*.bbappend \
"

# This folder should only contains specific patches to fix issue on oe recipes
# Note that these patches may be pushed on Community
BBFILES += "${LAYERDIR}/oe-core/recipes-*/*/*.bbappend"

# This folder should only contains direct backport from oe recipes
# These recipes may be suppress at next update on oe version
BBFILES += "${LAYERDIR}/oe-backport/recipes-*/*/*.bb \
            ${LAYERDIR}/oe-backport/recipes-*/*/*.bbappend \
"

BBFILE_COLLECTIONS += "st-openstlinux"
BBFILE_PATTERN_st-openstlinux := "^${LAYERDIR}/"
BBFILE_PRIORITY_st-openstlinux = "5"

LAYERDEPENDS_st-openstlinux = " "
# dependency with meta-networking for netperf, ntp
LAYERDEPENDS_st-openstlinux += " networking-layer "
# dependency with meta-webserver for netdata
LAYERDEPENDS_st-openstlinux += " webserver "
# dependency with meta-gnome for stsprof
LAYERDEPENDS_st-openstlinux += " gnome-layer "
# dependency with meta-multimedia for gstreamer dependency (faac)
LAYERDEPENDS_st-openstlinux += " multimedia-layer"

# Set a variable to get the openstlinux location
OPENSTLINUX_BASE = "${LAYERDIR}"

# This should only be incremented on significant changes that will
# cause compatibility issues with other layers
LAYERVERSION_st-openstlinux = "1"
LAYERSERIES_COMPAT_st-openstlinux = "scarthgap"

INHERIT += "check-st-openstlinux-compatibility"
# OpenSTLinux compatibility version
ST_OSTL_COMPATIBILITY_VERSION_st-openstlinux = "6.1"
```
